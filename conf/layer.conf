## conf/layer.conf
```bitbake
# We have a conf and classes directory, add to BBPATH
BBPATH .= ":${LAYERDIR}"

# We have a recipes-* directories, add to BBFILES
BBFILES += "${LAYERDIR}/recipes-*/*/*.bb \
	${LAYERDIR}/recipes-*/*/*.bbappend"

BBFILE_COLLECTIONS += "pcduino3"
BBFILE_PATTERN_pcduino3 = "^${LAYERDIR}/"
BBFILE_PRIORITY_pcduino3 = "6"
```

## conf/machine/pcduino3.conf
```bitbake
#@TYPE: Machine
#@NAME: pcduino3

#@DESCRIPTION: Machine configuration for pcduino3 systems


MACHINE_EXTRA_RRECOMMENDS = " kernel-modules kernel-devicetree"

EXTRA_IMAGEDEPENDS += "u-boot"

include conf/machine/include/tune-cortexa7.inc

IMAGE_FSTYPES += "tar.bz2 ext4"

SERIAL_CONSOLE = "115200 ttyS0"

PREFERRED_PROVIDER_virtual/kernel ?= "linux-yocto-custom"


KERNEL_IMAGETYPE = "zImage"
KERNEL_DEVICETREE = "sun7i-a20-pcduino3-nano.dtb"
KERNEL_EXTRA_ARGS += "LOADADDR=${UBOOT_ENTRYPOINT}"

SPL_BINARY = "u-boot-sunxi-with-spl.bin"
UBOOT_MACHINE = "Linksprite_pcDuino3_Nano_defconfig"
UBOOT_ENTRYPOINT = "0x40008000"
UBOOT_LOADADDRESS = "0x40008000"

MACHINE_FEATURES = "usbgadget usbhost vfat alsa"

IMAGE_BOOT_FILES ?= "u-boot-sunxi-with-spl.bin"
```
